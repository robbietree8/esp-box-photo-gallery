## main/Kconfig.projbuild
```kconfig
menu "App Configuration"
    config VOLUME_LEVEL
        int "volume level"
        default "50"
        range 1 100
endmenu
```

## sdkconfig.defaults
```kconfig
#
# Partition Table
#
# CONFIG_PARTITION_TABLE_SINGLE_APP is not set
# CONFIG_PARTITION_TABLE_SINGLE_APP_LARGE is not set
# CONFIG_PARTITION_TABLE_TWO_OTA is not set
CONFIG_PARTITION_TABLE_CUSTOM=y
CONFIG_PARTITION_TABLE_CUSTOM_FILENAME="partitions.csv"
CONFIG_PARTITION_TABLE_FILENAME="partitions.csv"
CONFIG_PARTITION_TABLE_OFFSET=0x8000
CONFIG_PARTITION_TABLE_MD5=y
# end of Partition Table

CONFIG_IDF_TARGET="esp32s3"

CONFIG_ESP_SYSTEM_PANIC_PRINT_HALT=y

CONFIG_ESP_CONSOLE_USB_SERIAL_JTAG=y

CONFIG_ESP32S3_DATA_CACHE_64KB=y
CONFIG_ESP32S3_DATA_CACHE_LINE_64B=y
CONFIG_ESP32S3_INSTRUCTION_CACHE_32KB=y
CONFIG_ESP32S3_SPIRAM_SUPPORT=y

CONFIG_ESPTOOLPY_FLASHMODE_QIO=y
CONFIG_ESPTOOLPY_FLASHSIZE_16MB=y

CONFIG_LV_COLOR_16_SWAP=y
# 83 == 'S'
CONFIG_LV_FS_POSIX_LETTER=83
CONFIG_LV_MEM_CUSTOM=y
CONFIG_LV_USE_BMP=y
CONFIG_LV_USE_FS_POSIX=y
CONFIG_LV_USE_GIF=y
CONFIG_LV_USE_PNG=y
CONFIG_LV_USE_SJPG=y


CONFIG_SPIRAM_MODE_OCT=y
CONFIG_SPIRAM_SPEED_80M=y

# BSP
CONFIG_BSP_LCD_DRAW_BUF_HEIGHT=10
```
